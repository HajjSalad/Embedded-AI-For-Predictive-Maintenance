## CMakeLists.txt
```
# SPDX-License-Identifier: Apache-2.0

cmake_minimum_required(VERSION 3.20.0)

find_package(Zephyr REQUIRED HINTS $ENV{ZEPHYR_BASE})
project(detection)

# Add the tflite-micro module
set(TFLITE_MICRO_DIR ${CMAKE_CURRENT_SOURCE_DIR}/tflite-micro)
add_subdirectory(${TFLITE_MICRO_DIR})

# Add TensorFlow Lite Micro headers to include path
target_include_directories(app PRIVATE
    ${TFLITE_MICRO_DIR}
    ${TFLITE_MICRO_DIR}/tensorflow
    ${CMAKE_CURRENT_SOURCE_DIR}/third_party/flatbuffers/include  
)

# Add source files
target_sources(app PRIVATE src/main.c src/demo.cpp src/sensor.cpp src/sensor_wrapper.cpp src/tflite_wrapper.cpp src/autoencoder_model.cc)

target_sources(app PRIVATE
    # Core Micro runtime
    ${TFLITE_MICRO_DIR}/tensorflow/lite/micro/micro_interpreter.cc
    ${TFLITE_MICRO_DIR}/tensorflow/lite/micro/micro_allocator.cc
    ${TFLITE_MICRO_DIR}/tensorflow/lite/micro/debug_log.cc
    ${TFLITE_MICRO_DIR}/tensorflow/lite/micro/micro_profiler.cc
    ${TFLITE_MICRO_DIR}/tensorflow/lite/micro/memory_helpers.cc

    ${TFLITE_MICRO_DIR}/tensorflow/lite/array.cc

    # Kernel utilities
    ${TFLITE_MICRO_DIR}/tensorflow/lite/kernels/kernel_util.cc
)

# Include directories
target_include_directories(app PRIVATE include)

# Add model files to the app
target_sources(app PRIVATE ${CMAKE_CURRENT_SOURCE_DIR}/data/autoencoder.tflite)

# Enable C++ support
set(Zephyr_EXTRA_MODULES app)

# Specify the C++ standard library
set(CMAKE_CXX_STANDARD 17)
set(CMAKE_CXX_STANDARD_REQUIRED ON)
set(CMAKE_CXX_EXTENSIONS OFF)  # Disable compiler-specific extensions for portability

set(CMAKE_CXX_FLAGS "${CMAKE_CXX_FLAGS} -std=c++17")

# Enable C++ exception handling
set(CMAKE_EXE_LINKER_FLAGS "-lgcc -lc -lstdc++")

target_link_libraries(app PRIVATE -lstdc++)

# Optionally, set specific compiler flags if necessary
set(CMAKE_CXX_FLAGS "${CMAKE_CXX_FLAGS} -std=c++17")

set(CMAKE_CXX_STANDARD 17)
set(CMAKE_CXX_STANDARD_REQUIRED ON)
set(CMAKE_CXX_EXTENSIONS OFF)
```

## sample.yaml
```
sample:
  name: Anomaly Detection
  decriotion: Anomaly Detection for Predictive Maintenance
tests:
  sample.basic.blinky:
    tags:
      - LED
      - gpio
    filter: dt_enabled_alias_with_parent_compat("led0", "gpio-leds")
    depends_on: gpio
    harness: led
    integration_platforms:
      - frdm_k64f
```

## prj.conf
```kconfig
CONFIG_GPIO=y
CONFIG_PRINTK=y
CONFIG_NEWLIB_LIBC=y
CONFIG_FPU=y
CONFIG_TENSORFLOW_LITE_MICRO=y       
CONFIG_TENSORFLOW_LITE_MICRO_CMSIS_NN_KERNELS=y    

# Enable C++ support in Zephyr
CONFIG_CPP=y
CONFIG_REQUIRES_FULL_LIBCPP=y
CONFIG_COMMON_LIBC_MALLOC_ARENA_SIZE=128
```

## src/main.c
```c
/*
// main.c - Entry point and main flow of program
*/

#include "demo.h"
#include "sensor_wrapper.h"
#include "tflite_wrapper.h"
#include <time.h>
#include <stdio.h>
#include <stdlib.h>
#include <string.h>
#include <zephyr/kernel.h>
#include <zephyr/device.h>
#include <zephyr/sys/printk.h>
#include <zephyr/drivers/gpio.h>
#include <zephyr/sys/__assert.h>

#define PRIORITY             7
#define STACKSIZE           1024
#define NUM_MACHINES         3

#define LED0_NODE DT_ALIAS(led0)     // The devicetree node identifier for the "led0" alias

static const struct gpio_dt_spec led = GPIO_DT_SPEC_GET(LED0_NODE, gpios);

MachineHandle machines[NUM_MACHINES];

static const MachineConfig machine_configs[] = 
{
    {   "Air Compressor",
        {   {"Temperature", 60.0f, 100.0f},         // 60 - 100°C
            {"Pressure", 72.0f, 145.0f},            // 72 - 145 psi
            {"Vibration", 0.5f, 2.0f} },            // 0.5 - 2.0 mm/s
        3
    },
    {   "Steam Boiler",
        {   {"Temperature", 150.0f, 250.0f},        // 150 - 250°C
            {"Pressure", 87.0f, 360.0f},            // 87 - 360 psi
            {"", 0.0f, 0.0f} },                     // Leave these empty
        2
    },
    {   "Electric Motor",
        {   {"Temperature", 60.0f, 105.0f},         // 60 - 105°C
            {"", 0.0f, 0.0f},                       // Leave empty
            {"", 0.0f, 0.0f} },                     // Leave empty
        1
    }
};

void generate_machines() 
{
    //   To create and add machine:
    //   1. Increment NUM_MACHINES
    //   2. Create machine instance   

    // Create a Machine instance with specified sensors
    machines[0] = create_machine("Air_Compressor_1", AIR_COMPRESSOR);
    machines[1] = create_machine("Steam_Boiler_1", STEAM_BOILER);
    machines[2] = create_machine("Electric_Motor_1", ELECTRIC_MOTOR);

    // Print Machine details - name, sensors
    for (int i=0; i<NUM_MACHINES; i++) {
        describe_machine(machines[i]);
    }
}

// Thread to blink led0
void blink0(void) {
    int ret;

    // Check if the GPIO is ready 
    if (!gpio_is_ready_dt(&led)) { printk("Error: GPIO device not ready.\n"); return; }

    // Configure the LED pin as an output
    ret = gpio_pin_configure_dt(&led, GPIO_OUTPUT_ACTIVE);
    if (ret < 0) { printk("Error: Failed to configure GPIO pin.\n"); return; }

    while (1) {
        // Toggle the LED state
        ret = gpio_pin_toggle_dt(&led);
        if (ret < 0) { printk("Error: Failed to toggle GPIO pin.\n"); return; }

        k_msleep(1000);        
    }    
}

// Thread to read the sensor data into the machines
void set_data(void) 
{
    while (1)
    {
        printf("\nSet machines values:\n");
        for (int i=0; i<NUM_MACHINES; i++)              // Set values for all the sensors in each machine
        {
            MachineType type = get_machine_type(machines[i]);
            if (type < 0 || type >= (sizeof(machine_configs) / sizeof(machine_configs[0]))) {
                printf("Error: Invalid machine type %d\n", type);
                continue;
            }

            const MachineConfig* config = &machine_configs[type];           // Use MachineType to index into machine_configs 

            printf("%s:", config->name);
            for (int s=0; s < config->num_sensors; s++) {
                const SensorConfig* sensor = &config->sensors[s];
                
                if (strlen(sensor->name) == 0) continue;                    // Skip invalid sensors

                float range = sensor->max_value - sensor->min_value;
                float value = sensor->min_value + (rand() / (float)RAND_MAX) * range;

                set_sensor_value(machines[i], sensor->name, value);
                if (s == 0) {
                    printf(" %s = %.2f  [range %.1f-%.1f]\n",  
                        sensor->name, (double)value, (double)sensor->min_value, (double)sensor->max_value);
                } else {
                    printf("                %s = %.2f  [range %.1f-%.1f]\n",  
                        sensor->name, (double)value, (double)sensor->min_value, (double)sensor->max_value);
                }
            }
        }
        printf("\n");
        k_msleep(5000);  // Sleep for 3 seconds before printing again
    }
} 

// Thread to print sensor values of each machine
void print_data(void) 
{
    while (1) 
    {
        printf("\nGet machines values:\n");
        for (int i=0; i<NUM_MACHINES; i++)              
        {
            MachineType type = get_machine_type(machines[i]);
            if (type < 0 || type >= (sizeof(machine_configs) / sizeof(machine_configs[0]))) {
                printf("Error: Invalid machine type %d\n", type);
                continue;
            }

            const MachineConfig* config = &machine_configs[type];        // Use MachineType to index into machine_configs 

            printf("%s:", config->name);
            for (int s=0; s < config->num_sensors; s++) {
                const SensorConfig* sensor = &config->sensors[s];
                
                if (strlen(sensor->name) == 0) continue;                 // Skip invalid sensors

                float value = get_sensor_value(machines[i], sensor->name);
                if (s == 0) {
                    printf(" %s = %.2f\n",  
                        sensor->name, value);
                } else {
                    printf("                %s = %.2f\n",  
                        sensor->name, value);
                }
            }
        }
        printf("\n");
        k_msleep(5000);  // Sleep for 5 seconds before printing again
    }
}

// Start the threads
K_THREAD_DEFINE(blink0_id, STACKSIZE, blink0, NULL, NULL, NULL, PRIORITY, 0, 0);                    // Confirm the program is alive
K_THREAD_DEFINE(set_data_id, STACKSIZE, set_data, NULL, NULL, NULL, PRIORITY + 1, 0, 0);            // Read the sensor data into the machines
K_THREAD_DEFINE(print_data_id, STACKSIZE, print_data, NULL, NULL, NULL, PRIORITY + 2, 0, 0);        // Print the machine sensor values

int main(void) {
    
    printk("\n*** Program Start ***\n");                 // Program Start
    demo_init();                                         // Initialize the demo
    printk("Demo Message: %s\n", demo_get_message());    // Make sure C++ is working
    
    srand(time(NULL));          // Seed random number generator
    //generate_machines();        // Generate the machines

    tflite_setup();
    tflite_run_inference();

    while (1) {
        k_sleep(K_SECONDS(5));
        tflite_run_inference();
    }
    
    return 0;
}
```

## include/autoencoder_model.h
```c
#ifndef AUTOENCODER_MODEL_H_
#define AUTOENCODER_MODEL_H_

extern const unsigned char autoencoder_model_tflite[];
extern const unsigned int autoencoder_model_tflite_len;

#endif  // AUTOENCODER_MODEL_H_
```

## include/sensor.h
```c
#ifndef SENSOR_H
#define SENSOR_H

#include "sensor_wrapper.h"
#include <stdint.h>
#include <string>
#include <stdio.h>

#include <memory>
#include <vector>
#include <iostream>

class Sensor {
protected:
    float Value;
public:
    virtual void setValue(float value) = 0;
    virtual float readValue() = 0;
    virtual std::string getType() = 0;
    virtual ~Sensor() {}
};

class TempSensor : public Sensor {
public:
    void setValue(float value) override;
    float readValue() override;
    std::string getType() override;
};

class PressureSensor : public Sensor {
public:
    void setValue(float value) override;
    float readValue() override;
    std::string getType() override;
};

class VibrationSensor : public Sensor {
public:
    void setValue(float value) override;
    float readValue() override;
    std::string getType() override;
};

class SensorFactory {
public:
    static std::unique_ptr<Sensor> createSensor(const std::string& type);
};

// class Machine {
// public:
//     std::string name;
//     std::vector<std::unique_ptr<Sensor>> sensors;

//     Machine(const std::string& machineName, const std::vector<std::string>& sensorTypes);
//     void display() const;
//     void setSensorValue(const std::string& type, float value);
//     float getSensorValue(const std::string& type);
// };

class Machine {
private:
    MachineType type;  

public:
    std::string name;
    std::vector<std::unique_ptr<Sensor>> sensors;

    Machine(const std::string& machineName, const std::vector<std::string>& sensorTypes, MachineType machineType);
    
    void display() const;
    void setSensorValue(const std::string& type, float value);
    float getSensorValue(const std::string& type);
    MachineType getType() const { return type; }
};
    

#endif // SENSOR_H



// #ifndef SENSOR_H
// #define SENSOR_H

// #include <stdint.h>
// #include <string>
// #include <stdio.h>

// #include <memory>
// #include <vector>
// #include <iostream>


// // Base class Sensor
// class Sensor {
// protected:
//     float Value;
// public:
//     virtual void setValue(float value);
//     virtual float readValue() = 0;
//     virtual std::string getType() = 0;
//     virtual ~Sensor() {}
// };

// // Derived class TempSensor
// class TempSensor : public Sensor {
// public:
//     void setValue(float value) override;
//     float readValue() override;
//     std::string getType() override;
// };

// // Derived class PressureSensor
// class PressureSensor : public Sensor {
// public:
//     void setValue(float value) override;
//     float readValue() override;
//     std::string getType() override;
// };

// // Derived class VibrationSensor
// class VibrationSensor : public Sensor {
// public:
//     void setValue(float value) override;
//     float readValue() override;
//     std::string getType() override;
// };

// // class SensorFactory
// class SensorFactory {
// public:
//     static std::unique_ptr<Sensor> createSensor(const std::string& type);
// };

// // class Machine
// class Machine {
// public:
//     std::string name;
//     std::vector<std::unique_ptr<Sensor>> sensors;

//     Machine(const std::string& machineName, const std::vector<std::string>& sensorTypes);
//     void display() const;
//     void setSensorValue(const std::string& type, float value);
//     float getSensorValue(const std::string& type);
// };
    
// #endif // SENSOR_H
```

## include/sensor_wrapper.h
```c
#ifndef SENSOR_WRAPPER_H
#define SENSOR_WRAPPER_H

#ifdef __cplusplus
extern "C" {
#endif

typedef enum {
    AIR_COMPRESSOR,
    STEAM_BOILER,
    ELECTRIC_MOTOR
} MachineType;

typedef struct {
    const char* name;
    float min_value;
    float max_value;
} SensorConfig;

typedef struct {
    const char* name;
    SensorConfig sensors[3];
    int num_sensors;
} MachineConfig;

typedef void* MachineHandle;

MachineHandle create_machine(const char* machine_name, MachineType type);
void destroy_machine(MachineHandle handle);
void describe_machine(MachineHandle handle);
void set_sensor_value(MachineHandle handle, const char* sensor_type, float value);
float get_sensor_value(MachineHandle handle, const char* sensor_type);
const char* get_machine_type_string(MachineType type);
MachineType get_machine_type(MachineHandle handle);

#ifdef __cplusplus
}
#endif

#endif // SENSOR_WRAPPER_H


// #ifndef WRAPPER_H
// #define WRAPPER_H

// #ifdef __cplusplus
// extern "C" {
// #endif

// #include <stdlib.h>

// // 3 Types of Machines
// typedef enum {
//     AIR_COMPRESSOR,
//     STEAM_BOILER,
//     ELECTRIC_MOTOR
// } MachineType;

// // Machine Structure
// typedef struct {
//     char name[50];
//     MachineType type;                           // Type of the machine
//     int num_sensors;
// } MachineStruct;

// // Define the handle type for a Machine instance
// typedef void* MachineHandle;

// // Create a Machine instance
// MachineHandle create_machine(const char* machine_name, const char* sensor_types[], int num_sensors, MachineType type);

// // Destroy Machine instance
// void destroy_machine(MachineHandle handle);

// // Describe the Machine (e.g., list its sensors)
// void describe_machine(MachineHandle handle);

// // Set the value of a specific sensor in the Machine
// void set_sensor_value(MachineHandle handle, const char* sensor_type, float value);

// // Get the value of a specific sensor in the Machine
// float get_sensor_value(MachineHandle handle, const char* sensor_type);

// // Get string representation of MachineType
// const char* get_machine_type_string(MachineType type);

// #ifdef __cplusplus
// }
// #endif

// #endif // WRAPPER_H
```

## include/tflite_wrapper.h
```c
#ifndef TFLITE_WRAPPER_H
#define TFLITE_WRAPPER_H

#ifdef __cplusplus
extern "C" {
#endif

void tflite_setup(void);
void tflite_run_inference(void);

#ifdef __cplusplus
}
#endif

#endif // TFLITE_WRAPPER_H
```

## src/sensor.cpp
```c
/*
//  sensor.cpp - Sensor Base class that all sensors inherit from it
*/

#include "sensor.h"
#include <string>
#include <stdio.h>

#include <memory>
#include <vector>
#include <iostream>

// Sensor implementations
void TempSensor::setValue(float value) { Value = value; }
float TempSensor::readValue() { return Value; }
std::string TempSensor::getType() { return "Temperature"; }

void PressureSensor::setValue(float value) { Value = value; }
float PressureSensor::readValue() { return Value; }
std::string PressureSensor::getType() { return "Pressure"; }

void VibrationSensor::setValue(float value) { Value = value; }
float VibrationSensor::readValue() { return Value; }
std::string VibrationSensor::getType() { return "Vibration"; }

// SensorFactory implementation
std::unique_ptr<Sensor> SensorFactory::createSensor(const std::string& type) {
    if (type == "Temperature") {
        return std::unique_ptr<Sensor>(new TempSensor());
    } else if (type == "Pressure") {
        return std::unique_ptr<Sensor>(new PressureSensor());
    } else if (type == "Vibration") {
        return std::unique_ptr<Sensor>(new VibrationSensor());
    }
    return nullptr;
}

// Machine implementation
Machine::Machine(const std::string& machineName, const std::vector<std::string>& sensorTypes, MachineType machineType) 
    : type(machineType), name(machineName)  {
    for (const auto& type : sensorTypes) {
        auto sensor = SensorFactory::createSensor(type);
        if (sensor) {
            sensors.push_back(std::move(sensor));
        }
    }
}

void Machine::display() const {
    std::cout << "Machine: " << name << std::endl;
    for (const auto& sensor : sensors) {
        std::cout << "  - Sensor Type: " << sensor->getType() << std::endl;
    }
}

void Machine::setSensorValue(const std::string& type, float value) {
    for (auto& sensor : sensors) {
        if (sensor->getType() == type) {
            sensor->setValue(value);
            return;
        }
    }
    std::cout << "Sensor type " << type << " not found in machine " << name << std::endl;
}

float Machine::getSensorValue(const std::string& type) {
    for (const auto& sensor : sensors) {
        if (sensor->getType() == type) {
            return sensor->readValue();
        }
    }
    std::cout << "Sensor type " << type << " not found in machine " << name << std::endl;
    return -1.0f;
}



// /*
// //  sensor.cpp - Sensor Base class that all sensors inherit from it
// */

// #include "sensor.h"
// #include <string>
// #include <stdio.h>

// #include <memory>
// #include <vector>
// #include <iostream>

// // *** Sensor Base Implementation ***
// void Sensor::setValue(float value) {
//     Value = value;
// }

// // *** TempSensor Implementation ***
// void TempSensor::setValue(float value) {
//     Value = value;
// }
// float TempSensor::readValue() {
//     return Value;
// }
// std::string TempSensor::getType() {
//     return "Temperature";
// }

// // *** PressureSensor Implementation ***
// void PressureSensor::setValue(float value) {
//     Value = value;
// }
// float PressureSensor::readValue() {
//     return Value;
// }
// std::string PressureSensor::getType() {
//     return "Pressure";
// }

// // *** VibrationSensor Implementation ***
// void VibrationSensor::setValue(float value) {
//     Value = value;
// }
// float VibrationSensor::readValue() {
//     return Value;
// }
// std::string VibrationSensor::getType() {
//     return "Vibration";
// }

// // *** SensorFactory Implementation ***
// std::unique_ptr<Sensor> SensorFactory::createSensor(const std::string& type) {
//     if (type == "Temperature") {
//         return std::unique_ptr<Sensor>(new TempSensor());
//     } else if (type == "Pressure") {
//         return std::unique_ptr<Sensor>(new PressureSensor());
//     } else if (type == "Vibration") {
//         return std::unique_ptr<Sensor>(new VibrationSensor());
//     } else {
//         return nullptr;
//     }
// }

// // *** Machine Implementation ***
// Machine::Machine(const std::string& machineName, const std::vector<std::string>& sensorTypes) {
//     name = machineName;
//     for (const auto& type : sensorTypes) {
//         auto sensor = SensorFactory::createSensor(type);
//         if (sensor) {
//             sensors.push_back(std::move(sensor));
//         }
//     }
// }

// void Machine::display() const {
//     std::cout << "Machine: " << name << std::endl;
//     for (const auto& sensor : sensors) {
//         std::cout << "  - Sensor Type: " << sensor->getType() << std::endl;
//     }
// }

// void Machine::setSensorValue(const std::string& type, float value) {
//     for (auto& sensor : sensors) {
//         if (sensor->getType() == type) {
//             sensor->setValue(value);
//             return;
//         }
//     }
//     std::cout << "Sensor type " << type << " not found in machine " << name << std::endl;
// }

// float Machine::getSensorValue(const std::string& type) {
//     for (const auto& sensor : sensors) {
//         if (sensor->getType() == type) {
//             return sensor->readValue();
//         }
//     }
//     std::cout << "Sensor type " << type << " not found in machine " << name << std::endl;
//     return -1;
// }



// // // Base class Sensor
// // class Sensor {
// // protected:
// //     float Value;
// // public:
// //     virtual void setValue(float value) { Value = value; }
// //     virtual float readValue() = 0;
// //     virtual std::string getType() = 0;
// //     virtual ~Sensor() {}
// // };
    
// // // class TempSensor
// // class TempSensor : public Sensor {
// // public:
// //     void setValue(float value) override { Value = value; }
// //     float readValue() override { return Value; }
// //     std::string getType() override { return "Temperature"; }
// // };

// // // class PressureSensor
// // class PressureSensor : public Sensor {
// // public:
// //     void setValue(float value) override { Value = value; }
// //     float readValue() override { return Value; }
// //     std::string getType() override { return "Pressure"; }
// // };
    
// // // class VibrationSensor
// // class VibrationSensor : public Sensor {
// // public:
// //     void setValue(float value) override { Value = value; }
// //     float readValue() override { return Value; }
// //     std::string getType() override { return "Vibration"; }
// // };

// // // Create sensor based on string identifier
// // class SensorFactory {
// // public:
// //     // Return std::unique_ptr to corresponding Sensor object.
// //     static std::unique_ptr<Sensor> createSensor(const std::string& type) {
// //         if (type == "Temperature") {
// //             return std::make_unique<TempSensor>();
// //         } else if (type == "Pressure") {
// //             return std::make_unique<PressureSensor>();
// //         } else if (type == "Vibration") {
// //             return std::make_unique<VibrationSensor>();
// //         } else {
// //             return nullptr; // Invalid type
// //         }
// //     }
// // };

// // // A Machine has a set of sensors
// // class Machine {
// // public:
// //     std::string name;               // Name of the machine

// //     // Vector to hold unique pointers to Sensor objects
// //     std::vector<std::unique_ptr<Sensor>> sensors;

// //     // Constructor creates the corresponding Sensor objects
// //     Machine(const std::string& machineName, const std::vector<std::string>& sensorTypes) {
// //         name = machineName;

// //         // Loop through each sensor type string provided
// //         for (const auto& type : sensorTypes) {
// //             // Create the sensor
// //             auto sensor = SensorFactory::createSensor(type);

// //             // If sensor creation was successful, add it to the vector
// //             if (sensor) {
// //                 sensors.push_back(std::move(sensor));
// //             }
// //         }
// //     }
// // }
























// // // Base class Sensor
// // class Sensor {
// // protected:
// //     float Value;
// // public:
// //     virtual void setValue(float value) {
// //         Value = value;
// //     }
// //     virtual float readValue() = 0;      
// //     virtual std::string getType() = 0;
// //     virtual ~Sensor() {}                // Virtual destructor for polymorphism
// // };

// // // class TempSensor
// // class TempSensor : public Sensor {
// // public:
// //     void setValue(float value) override {
// //         Value = value;
// //     }
// //     float readValue() override {
// //         return Value;
// //     }
// //     std::string getType() override {
// //         return "Temperature"
// //     }
// // };

// // // class PressureSensor
// // class PressureSensor : public Sensor {
// // public:
// //     void setValue(float value) override {
// //         Value = value;
// //     }
// //     float readValue() override {
// //         return Value;
// //     }
// //     std::string getType() override {
// //         return "Pressure"
// //     }
// // };

// // // class VibrationSensor
// // class VibrationSensor : public Sensor {
// // public:
// //     void setValue(float value) override {
// //         Value = value;
// //     }
// //     float readValue() override {
// //         return Value;
// //     }
// //     std::string getType() override {
// //         return "Vibration"
// //     }
// // };
    
// // // class SensorFactory
// // class SensorFactory {
// // public:
// //     static std::unique_ptr<Sensor> createSensor(const std::string& type) {
// //         if (type == "Temperature") {
// //             return std::make_unique<TemperatureSensor>();
// //         } else if (type == "Pressure") {
// //             return std::make_unique<PressureSensor>();
// //         } else if (type == "Vibration") {
// //             return std::make_unique<VibrationSensor>();
// //         } else {
// //             return nullptr;  // Invalid type
// //         }
// //     }
// // };
    
// // // class Machine
// // class Machine {
// // private:
// //     std::vector<std::unique_ptr<Sensor>> sensors;
// //     std::string name;

// // public:
// //     Machine(const std::string& machineName, const std::vector<std::string>& sensorType : name(machineName)) {
// //         for (const auto& type : sensorType) {
// //             auto sensor = SensorFactory::createSensor(type);
// //             if (sensor) sensors.push_back(std::move(sensor));
// //         }
// //     }
// // };

// // // C-compatible wrapper functions
// // extern "C" {
// //     typedef void* MachineHandle;

// //     MachineHandle create_machine(const char* machine_name, const char* sensor_types[], int num_sensors) {
// //         std::vector<std::string> sensorTypeVec;
// //         for (int i = 0; i < num_sensors; ++i) {
// //             sensorTypeVec.push_back(sensor_types[i]);
// //         }
// //         Machine* machine = new Machine(machine_name, sensorTypeVec);
// //         return reinterpret_cast<MachineHandle>(machine);
// //     }

// //     void display_machine(MachineHandle handle) {
// //         Machine* machine = reinterpret_cast<Machine*>(handle);
// //         machine->display();
// //     }

// //     void delete_machine(MachineHandle handle) {
// //         Machine* machine = reinterpret_cast<Machine*>(handle);
// //         delete machine;
// //     }
// // };
```

## src/sensor_wrapper.cpp
```c
#include "sensor.h"
#include "sensor_wrapper.h"
#include <vector>
#include <string>
#include <cstring>

// Define sensor types for each machine type
const std::vector<std::string> air_compressor_sensors = {"Temperature", "Pressure", "Vibration"};
const std::vector<std::string> steam_boiler_sensors = {"Temperature", "Pressure"};
const std::vector<std::string> electric_motor_sensors = {"Temperature"};

MachineHandle create_machine(const char* machine_name, MachineType type) {
    std::vector<std::string> sensors;
    
    switch(type) {
        case AIR_COMPRESSOR:
            sensors = air_compressor_sensors;
            break;
        case STEAM_BOILER:
            sensors = steam_boiler_sensors;
            break;
        case ELECTRIC_MOTOR:
            sensors = electric_motor_sensors;
            break;
    }
    
    Machine* machine = new Machine(std::string(machine_name), sensors, type);
    return reinterpret_cast<MachineHandle>(machine);
}

void destroy_machine(MachineHandle handle) {
    Machine* machine = reinterpret_cast<Machine*>(handle);
    delete machine;
}

void describe_machine(MachineHandle handle) {
    Machine* machine = reinterpret_cast<Machine*>(handle);
    machine->display();
}

void set_sensor_value(MachineHandle handle, const char* sensor_type, float value) {
    Machine* machine = reinterpret_cast<Machine*>(handle);
    machine->setSensorValue(sensor_type, value);
}

float get_sensor_value(MachineHandle handle, const char* sensor_type) {
    Machine* machine = reinterpret_cast<Machine*>(handle);
    return machine->getSensorValue(sensor_type);
}

const char* get_machine_type_string(MachineType type) {
    switch (type) {
        case AIR_COMPRESSOR: return "Air Compressor";
        case STEAM_BOILER: return "Steam Boiler";
        case ELECTRIC_MOTOR: return "Electric Motor";
        default: return "Unknown Type";
    }
}

MachineType get_machine_type(MachineHandle handle) {
    Machine* machine = reinterpret_cast<Machine*>(handle);
    return machine->getType();
}



// #include "sensor.h"
// #include "wrapper.h"

// #include <stdint.h>
// #include <string>
// #include <stdio.h>

// #include <memory>
// #include <vector>
// #include <iostream>
// #include <cstddef>
// #include <cstdlib>
// #include <cstring>
// #include <stdlib.h>
// #include <new>

// // Wrapper function to create a Machine instance
// MachineHandle create_machine(const char* machine_name, const char* sensor_types[], int num_sensors, MachineType type) {
//     // Create a new Machine object dynamically
//     MachineStruct* machine = new MachineStruct;
    
//     // Set machine name
//     strncpy(machine->name, machine_name, sizeof(machine->name) - 1);
    
//     // Set machine type
//     machine->type = type;
    
//     // Set number of sensors
//     machine->num_sensors = num_sensors;

//     // Store the sensor types in a vector
//     for (int i = 0; i < num_sensors; ++i) {
//         machine->sensor_types.push_back(sensor_types[i]);
//     }

//     // Return machine handle (casting Machine pointer to MachineHandle)
//     return reinterpret_cast<MachineHandle>(machine);
//     // std::vector<std::string> sensorTypeVec;
//     // for (int i = 0; i < num_sensors; ++i) {
//     //     sensorTypeVec.push_back(sensor_types[i]);
//     // }
//     // Machine* machine = new Machine(machine_name, sensorTypeVec);
//     // return reinterpret_cast<MachineHandle>(machine);
// }

// // Wrapper function to destroy the Machine instance
// void destroy_machine(MachineHandle handle) {
//     MachineStruct* machine = reinterpret_cast<Machine*>(handle);
//     delete machine;
// }

// // Wrapper function to describe the Machine (e.g., list its sensors)
// void describe_machine(MachineHandle handle) {
//     MachineStruct* machine = reinterpret_cast<Machine*>(handle);
//     machine->display();
// }

// // Wrapper function to set a specific sensor value in the Machine
// void set_sensor_value(MachineHandle handle, const char* sensor_type, float value) {
//     MachineStruct* machine = reinterpret_cast<Machine*>(handle);
//     machine->setSensorValue(sensor_type, value);
// }

// // Wrapper function to get a specific sensor value from the Machine
// float get_sensor_value(MachineHandle handle, const char* sensor_type) {
//     MachineStruct* machine = reinterpret_cast<Machine*>(handle);
//     return machine->getSensorValue(sensor_type);
// }

// // Get string representation of MachineType
// const char* get_machine_type_string(MachineType type) {
//     switch (type) {
//         case AIR_COMPRESSOR:
//             return "Air Compressor";
//         case STEAM_BOILER:
//             return "Steam Boiler";
//         case ELECTRIC_MOTOR:
//             return "Electric Motor";
//         default:
//             return "Unknown Type";
//     }
// }
```

## src/tflite_wrapper.cpp
```c
#include <stdio.h>
#include <stdlib.h>
#include <zephyr/kernel.h>
#include <zephyr/device.h>
#include <zephyr/sys/printk.h>
#include <zephyr/drivers/gpio.h>
#include <zephyr/sys/__assert.h>

#include "autoencoder_model.h"
#include <tensorflow/lite/micro/micro_interpreter.h>
#include <tensorflow/lite/micro/micro_op_resolver.h>
#include <tensorflow/lite/micro/micro_mutable_op_resolver.h>
#include <tensorflow/lite/schema/schema_generated.h>

#define TENSOR_ARENA_SIZE       10 * 1024

static uint8_t tensor_arena[TENSOR_ARENA_SIZE];

const tflite::Model* model = NULL;
tflite::MicroInterpreter* interpreter = NULL;
TfLiteTensor* input = NULL;
TfLiteTensor* output = NULL;

extern "C" void tflite_setup()
{
    // Load model
    model = tflite::GetModel(autoencoder_model_tflite);
    if (model->version() != TFLITE_SCHEMA_VERSION) {
        printk("Model schema mismatch!\n");
        return;
    }

    // Set up operator resolver (includes all ops)
    static tflite::MicroMutableOpResolver<5> resolver;
    resolver.AddFullyConnected();
    resolver.AddRelu();
    resolver.AddReshape();
    resolver.AddSoftmax();

    // Set up interpreter
    static tflite::MicroInterpreter static_interpreter(
        model, resolver, tensor_arena, TENSOR_ARENA_SIZE);
    interpreter = &static_interpreter;

    // Allocate tensor buffers
    TfLiteStatus allocate_status = interpreter->AllocateTensors();
    if (allocate_status != kTfLiteOk) {
        printk("AllocateTensors() failed\n");
        return;
    }

    // Get input/output tensors
    input = interpreter->input(0);
    output = interpreter->output(0);

    printk("TFLite Micro setup complete!\n");
}

extern "C" void tflite_run_inference() 
{
    // Example: Fill input with dummy data (e.g., all 0.5)
    for (int i = 0; i < input->bytes / sizeof(float); i++) {
        input->data.f[i] = 0.5f;
    }

    // Run inference
    TfLiteStatus invoke_status = interpreter->Invoke();
    if (invoke_status != kTfLiteOk) {
        printk("Invoke failed!\n");
        return;
    }

    // Print output
    for (int i = 0; i < output->bytes / sizeof(float); i++) {
        printk("Output[%d]: %f\n", i, output->data.f[i]);
    }
}
```
